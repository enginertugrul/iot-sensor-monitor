#include <UIPEthernet.h>
#include <avr/pgmspace.h>
#include <math.h>
#include <stdlib.h>
#include <string.h>

// -----------------------------------------------------------------------------
// Hardware configuration
// -----------------------------------------------------------------------------

const uint8_t THERMISTOR_PIN = A5;
const uint8_t ENC28J60_CS_PIN = 10;

// Nano hardware SPI pins used automatically by UIPEthernet:
// D11 = MOSI, D12 = MISO, D13 = SCK.

// -----------------------------------------------------------------------------
// Network configuration
// -----------------------------------------------------------------------------

const IPAddress BACKEND_IP(192,168,0,128);
const uint16_t BACKEND_PORT = 8080;

// Cloudflare's documented public anycast NTP address.
// Replace this with a trusted LAN NTP server if one is available.
const IPAddress NTP_SERVER_IP(162,159,200,1);
const uint16_t NTP_PORT = 123;
const uint16_t NTP_LOCAL_PORT = 8888;

// Paste the exact token generated by the application.
// PROGMEM keeps the token out of the Nano's limited SRAM.
const char SENSOR_TOKEN[] PROGMEM = "PASTE_SENSOR_TOKEN_HERE";
const uint16_t SENSOR_TOKEN_LENGTH = sizeof(SENSOR_TOKEN) - 1;

// -----------------------------------------------------------------------------
// Timing configuration
// -----------------------------------------------------------------------------

const uint32_t POST_INTERVAL_MS = 10000UL;
const uint32_t NTP_SYNC_INTERVAL_SECONDS = 3600UL;
const uint32_t NTP_RETRY_INTERVAL_MS = 60000UL;
const uint32_t NTP_ARP_TIMEOUT_MS = 1500UL;
const uint32_t NTP_RESPONSE_TIMEOUT_MS = 2500UL;

const uint8_t NTP_PACKET_SIZE = 48;

// Difference between the NTP 1900 epoch and Unix 1970 epoch.
const uint32_t NTP_UNIX_OFFSET = 2208988800UL;

// Used after the NTP timestamp wraps into era 1 in February 2036.
const uint32_t NTP_ERA_1_UNIX_OFFSET = 2085978496UL;

// Reject obviously corrupted or historical NTP responses.
const uint32_t EARLIEST_REASONABLE_UNIX_TIME = 1704067200UL; // 2024-01-01 UTC

EthernetClient client;

// NTP processing and HTTP formatting never happen simultaneously, so the same
// 48 bytes can be reused. This reduces permanent SRAM consumption.
union ScratchBuffer {
    uint8_t ntpPacket[NTP_PACKET_SIZE];
    char epochMilliseconds[14]; // 13 decimal digits plus '\0'
};

ScratchBuffer scratch;

// -----------------------------------------------------------------------------
// Software clock state
// -----------------------------------------------------------------------------

bool clockValid = false;

// Avoid uint64_t clock arithmetic by keeping seconds and milliseconds separate.
uint32_t clockEpochSeconds = 0;
uint16_t clockMillisecondPart = 0;
uint32_t clockLastTickMillis = 0;

uint32_t lastNtpSuccessEpochSeconds = 0;
uint32_t lastNtpAttemptMillis = 0;
uint32_t lastPostMillis = 0;

// -----------------------------------------------------------------------------
// Function declarations
// -----------------------------------------------------------------------------

void advanceClock();
bool synchronizeClockFromNtp();
void drainHttpResponse();
void formatEpochMilliseconds(uint32_t epochSeconds,uint16_t milliseconds,char *output);
void formatTemperature(float value,char *output);
void sendTemperature(float celsius,uint32_t recordedAtSeconds,uint16_t recordedAtMilliseconds);
float thermistor(uint16_t adcValue);

// -----------------------------------------------------------------------------
// Setup
// -----------------------------------------------------------------------------

void setup() {
    Serial.begin(9600);
    pinMode(THERMISTOR_PIN,INPUT);

    // Explicitly select D10 as the ENC28J60 chip-select pin.
    Ethernet.init(ENC28J60_CS_PIN);

    // The MAC must be unique within the local network.
    byte mac[] = {0xDE,0xAD,0xBE,0xEF,0xFE,0xED};

    // Static configuration order:
    // MAC, Nano IP, DNS server, gateway, subnet mask.
    // Change the .1 gateway/DNS values if your router uses another address.
    Ethernet.begin(
            mac,
            IPAddress(192,168,0,50),
            IPAddress(192,168,0,1),
            IPAddress(192,168,0,1),
            IPAddress(255,255,255,0));

    delay(1000);

    Serial.print(F("Nano IP: "));
    Serial.println(Ethernet.localIP());

    // Do not post any readings until absolute UTC time is known.
    lastNtpAttemptMillis = millis();

    if (synchronizeClockFromNtp()) {
        Serial.println(F("Initial NTP synchronization succeeded."));
    } else {
        Serial.println(F("Initial NTP synchronization failed; POSTs are paused."));
    }

    lastPostMillis = millis();
}

// -----------------------------------------------------------------------------
// Main loop
// -----------------------------------------------------------------------------

void loop() {
    // Consume the backend response so the ENC28J60 receive buffers are released.
    drainHttpResponse();

    // Incremental updates remain valid across millis() rollover.
    advanceClock();

    const uint32_t nowMillis = millis();

    const bool ntpDue =
            !clockValid ||
            (uint32_t)(clockEpochSeconds - lastNtpSuccessEpochSeconds) >=
                    NTP_SYNC_INTERVAL_SECONDS;

    // Retry every minute while unsynchronized or after an hourly sync failure.
    // Do not interrupt an HTTP exchange to perform NTP synchronization.
    if (ntpDue &&
            !client.connected() &&
            (uint32_t)(nowMillis - lastNtpAttemptMillis) >= NTP_RETRY_INTERVAL_MS) {

        lastNtpAttemptMillis = nowMillis;

        if (synchronizeClockFromNtp()) {
            Serial.println(F("NTP clock synchronized."));
        } else {
            Serial.println(F("NTP synchronization failed; retaining prior clock."));
        }
    }

    const uint32_t postCheckMillis = millis();

    if (clockValid &&
            (uint32_t)(postCheckMillis - lastPostMillis) >= POST_INTERVAL_MS) {

        // Record failed attempts too, preventing a tight reconnection loop.
        lastPostMillis = postCheckMillis;

        const uint16_t adcValue = analogRead(THERMISTOR_PIN);

        // Timestamp the actual sensor sample, not the later HTTP transmission.
        advanceClock();
        const uint32_t recordedAtSeconds = clockEpochSeconds;
        const uint16_t recordedAtMilliseconds = clockMillisecondPart;

        if (adcValue == 0) {
            Serial.println(F("Invalid ADC value; reading skipped."));
            return;
        }

        const float temperature = thermistor(adcValue);

        if (isnan(temperature) ||
                isinf(temperature) ||
                temperature < -273.15f) {
            Serial.println(F("Invalid temperature; reading skipped."));
            return;
        }

        sendTemperature(temperature,recordedAtSeconds,recordedAtMilliseconds);
    }
}

// -----------------------------------------------------------------------------
// Software-clock maintenance
// -----------------------------------------------------------------------------

void advanceClock() {
    if (!clockValid) {
        return;
    }

    const uint32_t now = millis();
    const uint32_t elapsedMilliseconds =
            (uint32_t)(now - clockLastTickMillis);

    clockLastTickMillis = now;

    clockEpochSeconds += elapsedMilliseconds / 1000UL;

    uint16_t newMillisecondPart =
            clockMillisecondPart +
            (uint16_t)(elapsedMilliseconds % 1000UL);

    if (newMillisecondPart >= 1000U) {
        ++clockEpochSeconds;
        newMillisecondPart -= 1000U;
    }

    clockMillisecondPart = newMillisecondPart;
}

// -----------------------------------------------------------------------------
// NTP synchronization
// -----------------------------------------------------------------------------

bool synchronizeClockFromNtp() {
    // TCP and UDP are not needed simultaneously. Freeing the client first gives
    // UIPEthernet the maximum available packet resources.
    client.stop();

    EthernetUDP udp;

    if (!udp.begin(NTP_LOCAL_PORT)) {
        return false;
    }

    memset(scratch.ntpPacket,0,NTP_PACKET_SIZE);

    // LI=0, NTP version=4, mode=3 (client).
    scratch.ntpPacket[0] = 0x23;

    // UIPEthernet's first beginPacket() attempt can fail while ARP discovers
    // the gateway MAC address, so retry it for a short bounded period.
    const uint32_t arpStartedMillis = millis();

    while (!udp.beginPacket(NTP_SERVER_IP,NTP_PORT)) {
        if ((uint32_t)(millis() - arpStartedMillis) >= NTP_ARP_TIMEOUT_MS) {
            udp.stop();
            return false;
        }

        delay(10);
    }

    if (udp.write(scratch.ntpPacket,NTP_PACKET_SIZE) != NTP_PACKET_SIZE) {
        udp.stop();
        return false;
    }

    const uint32_t requestSentMillis = millis();

    if (udp.endPacket() != 1) {
        udp.stop();
        return false;
    }

    const uint32_t responseWaitStartedMillis = millis();

    while ((uint32_t)(millis() - responseWaitStartedMillis) <
            NTP_RESPONSE_TIMEOUT_MS) {

        const int packetSize = udp.parsePacket();

        if (packetSize <= 0) {
            delay(10);
            continue;
        }

        // Only accept a complete reply from the configured NTP endpoint.
        if (packetSize < NTP_PACKET_SIZE ||
                udp.remotePort() != NTP_PORT ||
                !(udp.remoteIP() == NTP_SERVER_IP)) {
            udp.flush();
            continue;
        }

        const int bytesRead = udp.read(scratch.ntpPacket,NTP_PACKET_SIZE);
        const uint32_t responseReceivedMillis = millis();

        // For a normal 48-byte response, read() has already released the packet.
        // flush() is also safe and discards any extension bytes.
        udp.flush();

        if (bytesRead < NTP_PACKET_SIZE) {
            continue;
        }

        const uint8_t firstByte = scratch.ntpPacket[0];
        const uint8_t leapIndicator = firstByte >> 6;
        const uint8_t version = (firstByte >> 3) & 0x07;
        const uint8_t mode = firstByte & 0x07;
        const uint8_t stratum = scratch.ntpPacket[1];

        // Mode 4 is a server response. Leap value 3 is unsynchronized.
        // Stratum 0 is a Kiss-o'-Death response.
        if ((version != 3 && version != 4) ||
                mode != 4 ||
                leapIndicator == 3 ||
                stratum == 0 ||
                stratum > 15) {
            udp.stop();
            return false;
        }

        // The server transmit timestamp starts at byte 40.
        const uint32_t ntpSeconds =
                ((uint32_t)scratch.ntpPacket[40] << 24) |
                ((uint32_t)scratch.ntpPacket[41] << 16) |
                ((uint32_t)scratch.ntpPacket[42] << 8) |
                (uint32_t)scratch.ntpPacket[43];

        const uint32_t ntpFraction =
                ((uint32_t)scratch.ntpPacket[44] << 24) |
                ((uint32_t)scratch.ntpPacket[45] << 16) |
                ((uint32_t)scratch.ntpPacket[46] << 8) |
                (uint32_t)scratch.ntpPacket[47];

        if (ntpSeconds == 0 && ntpFraction == 0) {
            udp.stop();
            return false;
        }

        // Convert NTP's 1900 epoch to Unix's 1970 epoch. The second branch
        // handles the NTP era rollover beginning in February 2036.
        const uint32_t unixSeconds =
                ntpSeconds >= NTP_UNIX_OFFSET
                        ? ntpSeconds - NTP_UNIX_OFFSET
                        : ntpSeconds + NTP_ERA_1_UNIX_OFFSET;

        if (unixSeconds < EARLIEST_REASONABLE_UNIX_TIME) {
            udp.stop();
            return false;
        }

        // The high 16 fractional bits provide adequate millisecond precision
        // without requiring uint64_t multiplication.
        const uint16_t fractionHigh = (uint16_t)(ntpFraction >> 16);

        const uint16_t ntpFractionMilliseconds =
                (uint16_t)(((uint32_t)fractionHigh * 1000UL) >> 16);

        // The transmit timestamp was produced before the response travelled
        // back to the Nano. Half the round trip is a small delay estimate.
        const uint16_t halfRoundTripMilliseconds =
                (uint16_t)(
                        (uint32_t)(responseReceivedMillis - requestSentMillis) /
                                2UL);

        const uint16_t adjustedMilliseconds =
                ntpFractionMilliseconds + halfRoundTripMilliseconds;

        clockEpochSeconds =
                unixSeconds + adjustedMilliseconds / 1000U;
        clockMillisecondPart =
                adjustedMilliseconds % 1000U;
        clockLastTickMillis = responseReceivedMillis;
        lastNtpSuccessEpochSeconds = clockEpochSeconds;
        clockValid = true;

        udp.stop();
        return true;
    }

    udp.stop();
    return false;
}

// -----------------------------------------------------------------------------
// HTTP ingestion
// -----------------------------------------------------------------------------

void sendTemperature(
        float celsius,
        uint32_t recordedAtSeconds,
        uint16_t recordedAtMilliseconds) {

    char temperatureText[16];

    formatTemperature(celsius,temperatureText);
    formatEpochMilliseconds(
            recordedAtSeconds,
            recordedAtMilliseconds,
            scratch.epochMilliseconds);

    // Exact body:
    // sensorToken=<token>&celsiusValue=<value>&recordedAt=<epochMillis>
    const uint16_t contentLength =
            (sizeof("sensorToken=") - 1) +
            SENSOR_TOKEN_LENGTH +
            (sizeof("&celsiusValue=") - 1) +
            strlen(temperatureText) +
            (sizeof("&recordedAt=") - 1) +
            strlen(scratch.epochMilliseconds);

    client.stop();

    Serial.print(F("Sending "));
    Serial.print(temperatureText);
    Serial.print(F(" C at epoch ms "));
    Serial.println(scratch.epochMilliseconds);

    if (!client.connect(BACKEND_IP,BACKEND_PORT)) {
        Serial.println(F("Backend connection failed."));
        return;
    }

    client.println(F("POST /readings/temperature HTTP/1.1"));

    // HTTP/1.1 Host should include the non-default port.
    client.print(F("Host: "));
    client.print(BACKEND_IP);
    client.print(':');
    client.println(BACKEND_PORT);

    client.println(F("Content-Type: application/x-www-form-urlencoded"));
    client.println(F("Connection: close"));
    client.print(F("Content-Length: "));
    client.println(contentLength);
    client.println();

    // The generated token is Base64 URL-safe. The timestamp and temperature
    // contain only form-safe numeric characters. Do not append a body newline.
    client.print(F("sensorToken="));
    client.print(
            reinterpret_cast<const __FlashStringHelper *>(SENSOR_TOKEN));
    client.print(F("&celsiusValue="));
    client.print(temperatureText);
    client.print(F("&recordedAt="));
    client.print(scratch.epochMilliseconds);

    Serial.println(F("POST dispatched."));
}

void drainHttpResponse() {
    while (client.available()) {
        Serial.write(client.read());
    }

    if (!client.connected()) {
        client.stop();
    }
}

// -----------------------------------------------------------------------------
// Allocation-free value formatting
// -----------------------------------------------------------------------------

void formatEpochMilliseconds(
        uint32_t epochSeconds,
        uint16_t milliseconds,
        char *output) {

    // Seconds followed by exactly three digits equals:
    // epochSeconds * 1000 + milliseconds.
    // This avoids uint64_t decimal conversion code.
    ultoa(epochSeconds,output,10);

    char *cursor = output;

    while (*cursor != '\0') {
        ++cursor;
    }

    *cursor++ = '0' + (milliseconds / 100U);
    *cursor++ = '0' + ((milliseconds / 10U) % 10U);
    *cursor++ = '0' + (milliseconds % 10U);
    *cursor = '\0';
}

void formatTemperature(float value,char *output) {
    // Convert to signed hundredths and round once. This avoids Arduino String
    // allocation and its long-running heap-fragmentation risk.
    const int32_t scaled =
            (int32_t)(
                    value * 100.0f +
                    (value >= 0.0f ? 0.5f : -0.5f));

    char *cursor = output;
    uint32_t magnitude;

    if (scaled < 0) {
        *cursor++ = '-';
        magnitude = (uint32_t)(-scaled);
    } else {
        magnitude = (uint32_t)scaled;
    }

    ultoa(magnitude / 100UL,cursor,10);

    while (*cursor != '\0') {
        ++cursor;
    }

    const uint8_t hundredths = (uint8_t)(magnitude % 100UL);

    *cursor++ = '.';
    *cursor++ = '0' + hundredths / 10U;
    *cursor++ = '0' + hundredths % 10U;
    *cursor = '\0';
}

// -----------------------------------------------------------------------------
// Thermistor conversion
// -----------------------------------------------------------------------------

float thermistor(uint16_t adcValue) {
    const float logResistance =
            log(
                    11000.0f *
                    ((1024.0f / (float)adcValue) - 1.0f));

    const float kelvin =
            1.0f /
                    (0.001129148f +
                            (0.000234125f +
                                    (0.0000000876741f *
                                            logResistance *
                                            logResistance)) *
                                    logResistance);

    return kelvin - 273.15f;
}